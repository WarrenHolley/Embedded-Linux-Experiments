/dts-v1/;
/plugin/; /* Marks that this is an overlay - Need to research what else there is. */

/ {
  fragment@0 {
    target-path = "/";   /* Adds to the root of the device tree */
    
    __overlay__ {
      wgh_gpio_led { /* Research: Addresses & labels */

        compatible = "wgh,gpio_experiment";
        /* No clue if this is relevant or needed. Apparently important, but I'm not yet sure of the context. */
        
        status = "okay";   /* Restricted to 'okay' or 'disable'? Could be more. */
        
        led-gpio = <&gpio 21 0>;
        /* GPIO 21->Pin 40 on the RPI header. (Last/Bottom right) - Right next to Pin 39/GND */
      };
    };
  };
};
